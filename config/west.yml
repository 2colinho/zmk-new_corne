## config/west.yml
```yaml
manifest:
  remotes:
    - name: zmkfirmware
      url-base: https://github.com/zmkfirmware
      # Additional modules containing boards/shields/custom code can be listed here as well.
      # See:
      # - https://zmk.dev/docs/features/modules
      # - https://docs.zephyrproject.org/3.5.0/develop/west/manifest.html#projects
    - name: urob
      url-base: https://github.com/urob
    - name: dhruvinsh
      url-base: https://github.com/dhruvinsh
  projects:
    - name: eyelash_corne
      url: https://github.com/a741725193/zmk-new_corne
      revision: 5956cfc3a1de293251cdfcf989863d963d4ec212
    - name: zmk
      remote: zmkfirmware
      revision: v0.3.0
      import: app/west.yml
    - name: zmk-auto-layer
      remote: urob
      revision: v0.3.0
    - name: zmk-leader-key
      remote: urob
      revision: v0.3.0
    - name: zmk-tri-state
      remote: dhruvinsh
      revision: ebbc1f0ccdb51669650bb0ac3e34920d09e62400
  self:
    path: config
```
